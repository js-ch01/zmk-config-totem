## config/west.yml
```yaml
manifest:
  remotes:
    - name: zmkfirmware
      url-base: https://github.com/zmkfirmware
  projects:
    - name: zmk
      remote: zmkfirmware
      revision: feat/pointers-with-input-processors #mousekey
      import: app/west.yml
  self:
    path: config
```
